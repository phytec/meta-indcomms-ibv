// SPDX-License-Identifier: GPL-2.0-only OR MIT
/*
 * Copyright (C) 2025 IBV - Echtzeit- und Embedded GmbH & Co. KG
 */

/dts-v1/;
/plugin/;

/ {
	compatible = "phytec,am642-phyboard-electra-rdk";
};

/* disable ICSSG1 */
&icssg1_mdio {
	status = "disabled";
};

&icssg1 {
	status = "disabled";
};
