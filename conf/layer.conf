## conf/layer.conf
```bitbake
# We have a conf and classes directory, add to BBPATH
BBPATH .= ":${LAYERDIR}"

# We have a recipes directory, add to BBFILES
BBFILES += "${LAYERDIR}/recipes-*/*/*.bb \
            ${LAYERDIR}/recipes-*/*/*.bbappend"

BBFILE_COLLECTIONS += "indcomms-ibv"
BBFILE_PATTERN_indcomms-ibv = "^${LAYERDIR}/"
BBFILE_PRIORITY_indcomms-ibv = "24"
LAYERSERIES_COMPAT_indcomms-ibv = "scarthgap"
LAYERDEPENDS_indcomms-ibv = "phytec ampliphy"

KERNEL_DEVICETREE:append:phyboard-electra-am64xx-2 = " \
	ti/k3-am642-phyboard-electra-ind-eth-demo_icssg0.dtbo \
	ti/k3-am642-phyboard-electra-ind-eth-demo_icssg1.dtbo \
	ti/k3-am642-phyboard-electra-ind-eth-demo_r5f.dtbo \
"

DISTRO_VERSION:append = "-indcomms-v0.1"
```
